## components/console2/Kconfig
```kconfig
menu "Console2 Component"

    config CONSOLE2_STORE_HISTORY
        bool "Store command history in memory"
        default y
        help
            Linenoise line editing library provides functions to save and load
            command history. If this option is enabled, each command will be save to memmory.

    config CONSOLE2_PRESSENTER_MSG
        bool "Print how to enter message"
        default y
        help
            After initialize and 'exit' CLI command will print
            message how to enter to console

    config CONSOLE2_MAX_COMMAND_LINE_LENGTH
        int "Maximum command line length"
        default 256
        help
            This value marks the maximum length of a single command line. Once it is
            reached, no more characters will be accepted by the console.

    config CONSOLE2_TASK_HEAP_STACK_SIZE
        int "Stack size for Console FreeRTOS task"
        default 3072
        help
            Stack size in bytes. Set size more than 2048 bytes.

    config CONSOLE2_GREETINGS_MESSAGE
        string "Greetings string"
        default "Welcome to the console command line interface"
        help
            Greetings message after enter console

endmenu
```
