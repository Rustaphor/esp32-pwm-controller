## sdkconfig.defaults
```kconfig
# Reduce bootloader log verbosity
CONFIG_BOOTLOADER_LOG_LEVEL_WARN=y
CONFIG_BOOTLOADER_LOG_LEVEL=2

# Increase main task stack size
CONFIG_ESP_MAIN_TASK_STACK_SIZE=7168

# Enable FreeRTOS stats formatting functions, needed for 'tasks' command
CONFIG_FREERTOS_USE_TRACE_FACILITY=y
CONFIG_FREERTOS_USE_STATS_FORMATTING_FUNCTIONS=y

# On chips with USB serial, disable secondary console which does not make sense when using console component
CONFIG_ESP_CONSOLE_SECONDARY_NONE=y

# LwIP Configuration
CONFIG_LWIP_IP_FORWARD=y
CONFIG_LWIP_IPV4_NAPT=y

# Minimal flash size
CONFIG_ESPTOOLPY_FLASHSIZE_4MB=y

# Disable Watchdog (for Debug only)
CONFIG_ESP_TASK_WDT_EN=n

#
# ESP-Driver:MCPWM Configurations
#
CONFIG_MCPWM_ISR_HANDLER_IN_IRAM=y
CONFIG_MCPWM_ISR_CACHE_SAFE=y
CONFIG_MCPWM_CTRL_FUNC_IN_IRAM=y

# GDB Stub (debugging via standart UART only. Read wiki for details)
# NOTE: 1. Conflicts with 'CLI Console' component. Switch off 'CLI Console' component to use it. Add debug information with compiling.
#       2. Must be disabled in Release ver.
CONFIG_ESP_SYSTEM_GDBSTUB_RUNTIME=n
CONFIG_ESP_GDBSTUB_SUPPORT_TASKS=y
```

## test-app/sdkconfig.defaults
```kconfig
CONFIG_ESP_TASK_WDT_EN=n
CONFIG_UNITY_ENABLE_FIXTURE=y

# GDB Stub (debugging via standart UART only. Read wiki for details)
# CONFIG_ESP_SYSTEM_GDBSTUB_RUNTIME=n
# CONFIG_ESP_GDBSTUB_SUPPORT_TASKS=y
```
